## drivers/rekernel/Kconfig
```kconfig
menu "Re:Kernel"

config REKERNEL
	bool "Re:Kernel module"
	depends on MODULES
	default n
	help
	  Re:Kernel integrated kernel driver (built-in) v11.0
	  Make tombstone users get a better experience.

config REKERNEL_NETWORK
	bool "Re:Kernel NetReceive unfreeze support"
	depends on REKERNEL
	default n
	help
	  Allow ReKernel to listen to network activity then send signal to tombstone.
endmenu
```
